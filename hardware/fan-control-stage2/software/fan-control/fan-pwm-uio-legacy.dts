/dts-v1/;
/plugin/;

/ {
    fragment@0 {
        target-path = "/axi";
        __overlay__ {
            #address-cells = <2>;
            #size-cells = <2>;
            fan-pwm@a0000000 {
                compatible = "generic-uio";
                reg = <0x0 0xa0000000 0x0 0x10000>;
                status = "okay";
            };
        };
    };
};
